//////////////////////////////////////////////////////////////////////////////////
// Company: Eindhoven University of Technology
// Author: Wouter Schoenmakers
// 
// Create Date: 14/01/2019
// Module Name: pl.dtsi
// Description: 5EIB0 lab 5 overlay file
// 
// Version: 1.0
//////////////////////////////////////////////////////////////////////////////////

/dts-v1/;
/plugin/;
/ {
	fragment@0 {
		target = <&fpga_full>;
		overlay0: __overlay__ {
			#address-cells = <1>;
			#size-cells = <1>;
			firmware-name = "design_1_wrapper.bit.bin";
		};
	};
	fragment@1 {
		target = <&amba>;
		overlay1: __overlay__ {
			clocking0: clocking0 {
				#clock-cells = <0>;
				assigned-clock-rates = <100000000>;
				assigned-clocks = <&clkc 15>;
				clock-output-names = "fabric_clk";
				clocks = <&clkc 15>;
				compatible = "xlnx,fclk";
			};
		};
	};
	fragment@2 {
		target = <&amba>;
		overlay2: __overlay__ {
			custom_counter_0: custom_counter@43c00000 {
				clock-names = "s00_axi_aclk";
				clocks = <&clkc 15>;
				compatible = "tue,custom-counter-1.0";
				reg = <0x43c00000 0x10000>;
				xlnx,s00-axi-addr-width = <0x4>;
				xlnx,s00-axi-data-width = <0x20>;
			};
		};
	};
};
